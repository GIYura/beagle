/ {
    /* gpio client */
    bone_gpio_devs {
        compatible="org,bone-gpio-sysfs";

        ds18b20-io {
            label="gpio2.7";
            bone-gpios=<&gpio2 7 GPIO_ACTIVE_HIGH>;
        };
    }; /* bone_gpio_devs */
}; /* root */

